AUTOSAR XML (schema 4-0-3)
package /TruckDatabase/Cluster
  can cluster Powertrain: speed=250000
    can physical channel Channel1
      frame EEC1_Frame: id 0xCF00400, frame-length=8, can-addressing-mode=EXTENDED
        pdu EEC1_PDU: length=8, transmission-mode-true-timing=cyclic-timing=time-period=0.1
          signal EngineSpeed: start 24, 16 bit, little-endian, init-value=0
          signal ActualTorque: start 8, 8 bit, little-endian, init-value=125
      frame CCVS_Frame: id 0x18F95100, frame-length=8, can-addressing-mode=EXTENDED
        pdu CCVS_PDU: length=8
          signal VehicleSpeed: start 8, 16 bit, little-endian, init-value=0
      frame ET_Frame: id 0x18F94E00, frame-length=8, can-addressing-mode=EXTENDED
        pdu ET_PDU: length=8
          signal CoolantTemp: start 0, 8 bit, little-endian, init-value=125
      frame HyvaSensor_Frame: id 0x18FA0063, frame-length=8, can-addressing-mode=EXTENDED
        pdu HyvaSensor_PDU: length=8
          signal InclinoLong: start 0, 16 bit, little-endian, init-value=20000
          signal InclinoLat: start 16, 16 bit, little-endian, init-value=18750
      frame HyvaHB_Frame: id 0xC000063, frame-length=8, can-addressing-mode=EXTENDED
        pdu HyvaHB_PDU: length=8
          signal SystemState: start 16, 8 bit, little-endian, init-value=0
          signal SequenceNumber: start 8, 8 bit, little-endian, init-value=0
      frame OBD2R_Frame: id 0x7E8, frame-length=8, can-addressing-mode=STANDARD
        pdu OBD2R_PDU: length=8
          signal OBD2_ServiceID: start 0, 8 bit, little-endian, init-value=0
      frame OBD2Q_Frame: id 0x7E0, frame-length=8, can-addressing-mode=STANDARD
        pdu OBD2Q_PDU: length=8
          signal OBD2_RequestedPID: start 8, 8 bit, little-endian, init-value=0
